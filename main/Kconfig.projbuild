## main/Kconfig.projbuild
```kconfig
menu "USB Microphone Configuration"

    config MIC_SAMPLE_RATE
        int "Audio Sample Rate"
        default 44100
        help
            Set the audio sample rate frequency. Usually 16000 or 44100 Hz if PCM data format supported.
            Oversample rate usually can be 2048000 or 5644800 Hz if only raw PDM data format supported.

    config MIC_BIT_DEPTH
        int "Audio Bit Depth"
        default 16
        help
            Define the number of bits for each sample. Default 16 bits per sample.
    
    menu "Microphone Pin Configurationn"

        config MIC_PIN_DATA
            int "I2S Data"
            default 41
            help
                Set data pin.
    
        config MIC_PIN_CLK
            int "I2S Clock"
            default 42
            help
                Set CLK pin.

    endmenu
endmenu

menu "USB WebCam Configuration"

    config CAMERA_XCLK_FREQ
        int "XCLK frequency"
        range 1000000 40000000
        default 20000000
        help
            Set XCLK frequency.

    menu "Camera Pin Configuration"

        config CAMERA_PIN_PWDN
            int "Power Down"
            default -1
            help
                Set Power Down pin or -1 for unmanaged.

        config CAMERA_PIN_RESET
            int "Reset"
            default -1
            help
                Set Reset pin or -1 for software reset.

        config CAMERA_PIN_XCLK
            int "XCLK"
            default 10
            help
                Set XCLK pin.

        config CAMERA_PIN_SIOD
            int "SIOD"
            default 40
            help
                Set SIOD pin.

        config CAMERA_PIN_SIOC
            int "SIOC"
            default 39
            help
                Set SIOC pin.

        config CAMERA_PIN_VSYNC
            int "VSYNC"
            default 38
            help
                Set VSYNC pin.

        config CAMERA_PIN_HREF
            int "HREF"
            default 47
            help
                Set HREF pin.

        config CAMERA_PIN_PCLK
            int "PCLK"
            default 13
            help
                Set PCLK pin.

        config CAMERA_PIN_Y2
            int "Y2"
            default 15
            help
                Set Y2 pin.

        config CAMERA_PIN_Y3
            int "Y3"
            default 17
            help
                Set Y3 pin.

        config CAMERA_PIN_Y4
            int "Y4"
            default 18
            help
                Set Y4 pin.

        config CAMERA_PIN_Y5
            int "Y5"
            default 16
            help
                Set Y5 pin.

        config CAMERA_PIN_Y6
            int "Y6"
            default 14
            help
                Set Y6 pin.

        config CAMERA_PIN_Y7
            int "Y7"
            default 12
            help
                Set Y7 pin.

        config CAMERA_PIN_Y8
            int "Y8"
            default 11
            help
                Set Y8 pin.

        config CAMERA_PIN_Y9
            int "Y9"
            default 48
            help
                Set Y9 pin.

    endmenu
endmenu
```

## sdkconfig.defaults
```kconfig
CONFIG_BOOTLOADER_COMPILER_OPTIMIZATION_PERF=y

CONFIG_ESPTOOLPY_FLASHMODE_QIO=y
CONFIG_ESPTOOLPY_FLASHSIZE_8MB=y
CONFIG_ESPTOOLPY_FLASHSIZE="8MB"

CONFIG_PARTITION_TABLE_CUSTOM=y
CONFIG_PARTITION_TABLE_FILENAME="partitions.csv"

CONFIG_COMPILER_OPTIMIZATION_PERF=y

CONFIG_SPIRAM=y
CONFIG_SPIRAM_MODE_OCT=y
CONFIG_SPIRAM_FETCH_INSTRUCTIONS=y
CONFIG_SPIRAM_RODATA=y
CONFIG_SPIRAM_SPEED_80M=y
CONFIG_SPIRAM_SPEED=80

CONFIG_ESP_DEFAULT_CPU_FREQ_MHZ_240=y
CONFIG_ESP_DEFAULT_CPU_FREQ_MHZ=240

CONFIG_ESP_SYSTEM_PANIC_REBOOT_DELAY_SECONDS=15

CONFIG_ESP_TASK_WDT_EN=n
CONFIG_FREERTOS_HZ=1000

CONFIG_FLASHMODE_QIO=y

CONFIG_TINYUSB_CDC_ENABLED=y
```
